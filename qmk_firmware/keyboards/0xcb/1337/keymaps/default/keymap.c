/*
Copyright 2021 0xCB - Conor Burns

This program is free software: you can redistribute it and/or modify
it under the terms of the GNU General Public License as published by
the Free Software Foundation, either version 2 of the License, or
(at your option) any later version.

This program is distributed in the hope that it will be useful,
but WITHOUT ANY WARRANTY; without even the implied warranty of
MERCHANTABILITY or FITNESS FOR A PARTICULAR PURPOSE.  See the
GNU General Public License for more details.

You should have received a copy of the GNU General Public License
along with this program.  If not, see <http://www.gnu.org/licenses/>.
*/
#include QMK_KEYBOARD_H

enum layer_names {
  _HOME,
  _MISC,
  _LED,
  _ADV
};

const uint16_t PROGMEM keymaps[][MATRIX_ROWS][MATRIX_COLS] = {
[_HOME] = LAYOUT(
    KC_DEL,  KC_END,   KC_MPLY,
    KC_F2,   KC_ENTER, TG(1),
    KC_MPRV, KC_MNXT,  TG(2)
),
[_MISC] = LAYOUT(
    _______, _______, _______,
    _______, _______, TG(1),
    _______, _______, TG(2)
),
[_LED] = LAYOUT(
    RGB_HUI, RGB_HUD, RGB_MOD,
    RGB_SAI, RGB_SAD, TG(1),
    RGB_SPI, RGB_SPD, TG(2)
),
[_ADV] = LAYOUT(
    _______, _______, _______,
    _______, _______, TG(1),
    _______, _______, TG(2)
)
};

#ifdef ENCODER_ENABLE
void encoder_update_user(uint8_t index, bool clockwise) {
  if(IS_LAYER_ON(_LED)) {
    if (clockwise){
      rgblight_increase_val();
    } else{
      rgblight_decrease_val();
    }
  } else {
    if (clockwise){
      tap_code(KC_VOLU);
    } else{
      tap_code(KC_VOLD);
    }
  }
}
#endif

// oled stuff :)
#ifdef OLED_DRIVER_ENABLE
uint16_t startup_timer;

oled_rotation_t oled_init_user(oled_rotation_t rotation) {
    startup_timer = timer_read();
    return rotation;
}

static void render_logo(void) {
  static const char PROGMEM my_logo[] = {
      // 'OLED', 128x64px
      0x00, 0x00, 0x00, 0x00, 0x00, 0x00, 0x00, 0x00, 0x00, 0x00, 0x00, 0x00, 0x00, 0x00, 0x00, 0x00,
      0x00, 0x00, 0x00, 0x00, 0x00, 0x00, 0x00, 0x00, 0x00, 0x00, 0x00, 0x00, 0x00, 0x00, 0x00, 0x00,
      0x00, 0x00, 0x00, 0x00, 0x00, 0x00, 0x00, 0x00, 0x00, 0x00, 0x00, 0x00, 0x00, 0x00, 0x00, 0x00,
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      0x10, 0x10, 0x28, 0x44, 0x28, 0x10, 0x00, 0x00, 0x00, 0x00, 0x00, 0x00, 0x00, 0x00, 0x00, 0x00
  };

  oled_write_raw_P(my_logo, sizeof(my_logo));
}
static void render_info(void) {
    // Host Keyboard Layer Status
    oled_write_P(PSTR("Layer: "), false);

    switch (get_highest_layer(layer_state)) {
        case _HOME:
            oled_write_ln_P(PSTR("HOME"), false);
            break;
        case _MISC:
            oled_write_ln_P(PSTR("MISC"), false);
            break;
        case _LED:
            oled_write_ln_P(PSTR("LED"), false);
            break;
        case _ADV:
            oled_write_ln_P(PSTR("ADV"), false);
            break;
        default:
    // Or use the write_ln shortcut over adding '\n' to the end of your string
            oled_write_ln_P(PSTR("Undefined"), false);
    }

    // Host Keyboard LED Status
    led_t led_state = host_keyboard_led_state();
    oled_write_P(led_state.num_lock ? PSTR("NUM ") : PSTR("    "), false);
    oled_write_P(led_state.caps_lock ? PSTR("CAP ") : PSTR("    "), false);
    oled_write_P(led_state.scroll_lock ? PSTR("SCR ") : PSTR("    "), false);
}

void oled_task_user(void) {
    static bool finished_timer = false;
    if ((timer_elapsed(startup_timer) < 5000) && !finished_timer) {
        render_logo();
    } else {
        finished_timer = true;
        render_info();
    }
}
#endif
